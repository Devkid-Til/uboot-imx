## board/freescale/smartcar/Kconfig
```kconfig
if TARGET_MX6ULL_SMARTCAR

config SYS_BOARD
	default "smartcar"

config SYS_VENDOR
	default "freescale"

config SYS_CONFIG_NAME
	default "smartcar"

config SYS_TEXT_BASE
	default 0x87800000
endif
```
